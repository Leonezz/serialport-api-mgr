## esp32-test-device/sdkconfig.defaults
```kconfig
# ESP-IDF Configuration Defaults for Serial Protocol Tester

# WiFi credentials - UPDATE THESE WITH YOUR NETWORK
CONFIG_ESP_WIFI_SSID="YourNetworkName"
CONFIG_ESP_WIFI_PASSWORD="YourPassword"

# Rust requires
CONFIG_ESP_MAIN_TASK_STACK_SIZE=32768

# WiFi
CONFIG_ESP_WIFI_STATIC_RX_BUFFER_NUM=10
CONFIG_ESP_WIFI_DYNAMIC_RX_BUFFER_NUM=32
CONFIG_ESP_WIFI_DYNAMIC_TX_BUFFER_NUM=32

# UART
CONFIG_UART_ISR_IN_IRAM=y

# HTTP Server
CONFIG_HTTPD_MAX_REQ_HDR_LEN=1024
CONFIG_HTTPD_MAX_URI_LEN=512

# Logging
CONFIG_LOG_DEFAULT_LEVEL_INFO=y
CONFIG_LOG_MAXIMUM_LEVEL_DEBUG=y

# Use default single factory partition (no OTA)
CONFIG_PARTITION_TABLE_SINGLE_APP=y

# Watchdog
CONFIG_ESP_TASK_WDT_TIMEOUT_S=10

# Flash size - 4MB minimum for comfort
CONFIG_ESPTOOLPY_FLASHSIZE_4MB=y
```
